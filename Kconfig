## config/boards/shields/unified_base/Kconfig.defconfig
```kconfig
if SHIELD_UNIFIED_BASE

config ZMK_KEYBOARD_NAME
    default "Unified Base"

if ZMK_RGB_UNDERGLOW

config WS2812_STRIP
    default y

config SPI
    default y

endif # ZMK_RGB_UNDERGLOW

endif # SHIELD_UNIFIED_BASE
```
