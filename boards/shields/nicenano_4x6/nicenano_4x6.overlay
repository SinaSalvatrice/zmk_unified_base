#include <dt-bindings/zmk/matrix_transform.h>

/ {
    chosen {
        zmk,kscan = &kscan0;
    };

    kscan0: kscan {
        compatible = "zmk,kscan-gpio-matrix";
        label = "KSCAN";
        diode-direction = "col2row";
        
        col-gpios
            = <&pro_micro 5 GPIO_ACTIVE_HIGH>  // B6
            , <&pro_micro 6 GPIO_ACTIVE_HIGH>  // B5
            , <&pro_micro 7 GPIO_ACTIVE_HIGH>  // B4
            , <&pro_micro 8 GPIO_ACTIVE_HIGH>  // F5
            ;

        row-gpios
            = <&pro_micro 21 GPIO_ACTIVE_HIGH> // D1
            , <&pro_micro 20 GPIO_ACTIVE_HIGH> // D0
            , <&pro_micro 4 GPIO_ACTIVE_HIGH>  // D4
            , <&pro_micro 0 GPIO_ACTIVE_HIGH>  // C6
            , <&pro_micro 1 GPIO_ACTIVE_HIGH>  // D7
            , <&pro_micro 2 GPIO_ACTIVE_HIGH>  // E6
            ;
    };
};
